## software/os_buildroot/Config.in
```kconfig
#
# Ternary Edge-RV Buildroot External Tree
#

source "$BR2_EXTERNAL_TERNARYEDGE_RV_PATH/package/npu-ternaria/Config.in"
source "$BR2_EXTERNAL_TERNARYEDGE_RV_PATH/package/npu-hal/Config.in"
source "$BR2_EXTERNAL_TERNARYEDGE_RV_PATH/package/user-app/Config.in"
```

## software/os_buildroot/configs/ternaryedge_rv_defconfig
```kconfig
BR2_riscv=y
BR2_RISCV_32=y
BR2_riscv_custom=y
BR2_RISCV_ISA_RVI=y
BR2_RISCV_ISA_RVM=y
BR2_RISCV_ISA_RVA=y
BR2_PACKAGE_HOST_LINUX_HEADERS_CUSTOM_6_18=y
BR2_DOWNLOAD_FORCE_CHECK_HASHES=y
BR2_SYSTEM_DHCP="eth0"
BR2_LINUX_KERNEL=y
BR2_LINUX_KERNEL_CUSTOM_VERSION=y
BR2_LINUX_KERNEL_CUSTOM_VERSION_VALUE="6.18.7"
BR2_LINUX_KERNEL_DEFCONFIG="rv32"
BR2_TARGET_ROOTFS_EXT2=y
BR2_TARGET_OPENSBI=y
BR2_TARGET_OPENSBI_CUSTOM_VERSION=y
BR2_TARGET_OPENSBI_CUSTOM_VERSION_VALUE="1.6"
BR2_TARGET_OPENSBI_PLAT="generic"
BR2_PACKAGE_HOST_QEMU=y
BR2_PACKAGE_HOST_QEMU_SYSTEM_MODE=y
BR2_LINUX_KERNEL_CONFIG_FRAGMENT_FILES="$(BR2_EXTERNAL_TERNARYEDGE_RV_PATH)/configs/kernel-npu.cfg"
BR2_PACKAGE_DOSFSTOOLS=y
BR2_PACKAGE_E2FSPROGS=y
BR2_PACKAGE_NPU_TERNARIA=y
BR2_PACKAGE_NPU_HAL=y
BR2_PACKAGE_USER_APP=y
```

## software/os_buildroot/package/npu-hal/Config.in
```kconfig
config BR2_PACKAGE_NPU_HAL
    bool "npu-hal"
    help
      NPU Hardware Abstraction Layer for Ternary Edge-RV.
      Provides libnpu_hal.a with npu_init, npu_predict, npu_deinit, etc.
```

## software/os_buildroot/package/npu-ternaria/Config.in
```kconfig
config BR2_PACKAGE_NPU_TERNARIA
    bool "npu-ternaria"
    depends on BR2_LINUX_KERNEL
    help
      NPU Ternaria kernel module for Ternary Edge-RV.
      Platform driver with DMA, IRQ, and IOCTL interface.
```

## software/os_buildroot/package/user-app/Config.in
```kconfig
config BR2_PACKAGE_USER_APP
    bool "user-app"
    depends on BR2_PACKAGE_NPU_HAL
    help
      User-space inference application for Ternary Edge-RV.
      Uses NPU HAL to perform digit recognition on MNIST images.
```
